/* USER CODE BEGIN Header */
/**
  ******************************************************************************
  * @file           : main.c
  * @brief          : Main program body
  ******************************************************************************
  * @attention
  *
  * <h2><center>&copy; Copyright (c) 2021 STMicroelectronics.
  * All rights reserved.</center></h2>
  *
  * This software component is licensed by ST under BSD 3-Clause license,
  * the "License"; You may not use this file except in compliance with the
  * License. You may obtain a copy of the License at:
  *                        opensource.org/licenses/BSD-3-Clause
  *
  ******************************************************************************
  */
/* USER CODE END Header */
/* Includes ------------------------------------------------------------------*/
#include "main.h"

/* Private includes ----------------------------------------------------------*/
/* USER CODE BEGIN Includes */
#include "SSD7317.h"
#include "rpc.h"
#include "tone.h"
#include "ArialBlack_36h.h"
#include "ArialBlack_arrows.h"
#include "battery-status-full.h"
#ifdef USE_FULL_ASSERT
#include <stdio.h>
#endif
/* USER CODE END Includes */

/* Private typedef -----------------------------------------------------------*/
/* USER CODE BEGIN PTD */

/* USER CODE END PTD */

/* Private define ------------------------------------------------------------*/
/* USER CODE BEGIN PD */
/* USER CODE END PD */

/* Private macro -------------------------------------------------------------*/
/* USER CODE BEGIN PM */

/* USER CODE END PM */

/* Private variables ---------------------------------------------------------*/
I2C_HandleTypeDef hi2c1;

SPI_HandleTypeDef hspi1;
DMA_HandleTypeDef hdma_spi1_tx;

TIM_HandleTypeDef htim2;

UART_HandleTypeDef huart2;
DMA_HandleTypeDef hdma_usart2_rx;

/* USER CODE BEGIN PV */

/* USER CODE END PV */

/* Private function prototypes -----------------------------------------------*/
void SystemClock_Config(void);

/* USER CODE BEGIN PFP */
void app_touch_task(void);
/* USER CODE END PFP */

/* Private user code ---------------------------------------------------------*/
/* USER CODE BEGIN 0 */
/**
 * @brief
 * \b Description:<br>
 * 	This function redirect printf() to UART2 port, i.e. VCP port.
 * \b Pre-requisite:<br>
 *  1. Define a new symbol #USE_FULL_ASSERT under
 *  	Project Properties>C/C++ General>Paths and Symbols>#Symbols>GNU C<br>
 *  2. Need two files: syscalls.c and sysmem.c to work. They are automatically
 *  	generated by STM32CubeIDE if you choose Nucleo Standard EVK as the hw platform
 */
#ifdef USE_FULL_ASSERT
/* @note Override __io_putchar() in syscalls.c */
int __io_putchar(int ch)
{
	HAL_UART_Transmit(&huart2, (uint8_t *)&ch, 1, 0xFFFF);
	return ch;
}
#endif

/**
 * @brief	Touch screen demo for this application
 */
#define LABEL_X 0
#define LABEL_Y 26
#define ICON_X	32
#define ICON_Y	80
#define ARROW_UP_X 0
#define ARROW_UP_Y 0
#define ARROW_DOWN_X	ARROW_UP_X
#define ARROW_DOWN_Y	ARROW_UP_Y
void app_touch_task(void)
{
	static bool sleep = false;
	static bool por = true;
	static uint16_t counter = 0;
	static char str[5];
	uint16_t label_w, label_h;
	ssd7317_get_stringsize(&ArialBlack_36h, "0000", &label_w, &label_h);
	rect_t label_bg = {LABEL_X, LABEL_Y, LABEL_X+label_w-1,LABEL_Y+label_h-1};

	if(por){
		snprintf(str, 5, "%d", counter);
		por = false;
		ssd7317_put_string(LABEL_X,LABEL_Y,&ArialBlack_36h,str,0);
		ssd7317_put_image(72,0,&batterystatusfull,0);
		ssd7317_put_char(ICON_X, ICON_Y, &ArialBlack_36h, 0x26f7, 0);
	}

	finger_t finger = ssd7317_get_gesture();

	switch(finger.act){
	case LONG_TAP_ANYKEY:
		ssd7317_enter_lpm();
		tone_pwm_set(500); tone_pwm_on();
		HAL_Delay(700); tone_pwm_off();
		sleep = true;
		break;
	case DOUBLE_TAP_ANYKEY:
		if(sleep){
			ssd7317_display_on();
			sleep=false;
		}
		break;
	case SINGLE_TAP_ANYKEY:
		if(finger.detail==SINGLE_TAP_KEY1 || finger.detail==SINGLE_TAP_KEY2){
			tone_pwm_set(200); tone_pwm_on();
			HAL_Delay(50); tone_pwm_off();
		}
		else if(finger.detail==SINGLE_TAP_KEY3 || finger.detail==SINGLE_TAP_KEY4){
			tone_pwm_set(1000);
			ssd7317_put_char(ICON_X, ICON_Y, &ArialBlack_36h, 0x26f7, 1);
			tone_pwm_on(); HAL_Delay(50);
			ssd7317_put_char(ICON_X, ICON_Y, &ArialBlack_36h, 0x26f7, 0);
			tone_pwm_off();
		}
		break;
	case SWIPE:
		if(!sleep){
			tone_pwm_set(500);
			tone_pwm_on();
			if(finger.detail==SWIPE_DOWN){
				ssd7317_put_char(ARROW_DOWN_X, ARROW_DOWN_Y, &ArialBlack_arrows, 0x21e9, 0);
				if(counter>0) counter--;
			}else{
				ssd7317_put_char(ARROW_UP_X, ARROW_UP_Y, &ArialBlack_arrows, 0x21e7, 0);
				(counter<9999)?(counter++):(counter=0);
			}
			snprintf(str, 5, "%d", counter);
			ssd7317_fill_color(label_bg, BLACK); //clear the label background
			HAL_Delay(20);
			ssd7317_put_string(LABEL_X, LABEL_Y, &ArialBlack_36h,str,0); //print new value
			tone_pwm_off();
		}
		break;
	case LARGE_OBJ:
		/* Your code to support large object detection here */
		break;
	case ACT_ERROR:
#ifdef USE_FULL_ASSERT
		assert_failed((uint8_t *)__FILE__, __LINE__);
#endif
		break;
	}
}
/* USER CODE END 0 */

/**
  * @brief  The application entry point.
  * @retval int
  */
int main(void)
{
  /* USER CODE BEGIN 1 */

  /* USER CODE END 1 */

  /* MCU Configuration--------------------------------------------------------*/

  /* Reset of all peripherals, Initializes the Flash interface and the Systick. */
  HAL_Init();

  /* USER CODE BEGIN Init */

  /* USER CODE END Init */

  /* Configure the system clock */
  SystemClock_Config();

  /* USER CODE BEGIN SysInit */

  /* USER CODE END SysInit */

  /* USER CODE BEGIN 2 */
  tone_pwm_init();
  ssd7317_init();
  rpc_uart_init();

  /* USER CODE END 2 */

  /* Infinite loop */
  /* USER CODE BEGIN WHILE */
  while (1)
  {
    /* USER CODE END WHILE */

    /* USER CODE BEGIN 3 */
	  app_touch_task();
	  rpc_main_task();
  }
  /* USER CODE END 3 */
}

/**
  * @brief System Clock Configuration
  * @retval None
  */
void SystemClock_Config(void)
{
  RCC_OscInitTypeDef RCC_OscInitStruct = {0};
  RCC_ClkInitTypeDef RCC_ClkInitStruct = {0};
  RCC_PeriphCLKInitTypeDef PeriphClkInit = {0};

  /** Initializes the RCC Oscillators according to the specified parameters
  * in the RCC_OscInitTypeDef structure.
  */
  RCC_OscInitStruct.OscillatorType = RCC_OSCILLATORTYPE_MSI;
  RCC_OscInitStruct.MSIState = RCC_MSI_ON;
  RCC_OscInitStruct.MSICalibrationValue = 0;
  RCC_OscInitStruct.MSIClockRange = RCC_MSIRANGE_6;
  RCC_OscInitStruct.PLL.PLLState = RCC_PLL_ON;
  RCC_OscInitStruct.PLL.PLLSource = RCC_PLLSOURCE_MSI;
  RCC_OscInitStruct.PLL.PLLM = 1;
  RCC_OscInitStruct.PLL.PLLN = 16;
  RCC_OscInitStruct.PLL.PLLP = RCC_PLLP_DIV7;
  RCC_OscInitStruct.PLL.PLLQ = RCC_PLLQ_DIV2;
  RCC_OscInitStruct.PLL.PLLR = RCC_PLLR_DIV2;
  if (HAL_RCC_OscConfig(&RCC_OscInitStruct) != HAL_OK)
  {
    Error_Handler();
  }
  /** Initializes the CPU, AHB and APB buses clocks
  */
  RCC_ClkInitStruct.ClockType = RCC_CLOCKTYPE_HCLK|RCC_CLOCKTYPE_SYSCLK
                              |RCC_CLOCKTYPE_PCLK1|RCC_CLOCKTYPE_PCLK2;
  RCC_ClkInitStruct.SYSCLKSource = RCC_SYSCLKSOURCE_PLLCLK;
  RCC_ClkInitStruct.AHBCLKDivider = RCC_SYSCLK_DIV1;
  RCC_ClkInitStruct.APB1CLKDivider = RCC_HCLK_DIV1;
  RCC_ClkInitStruct.APB2CLKDivider = RCC_HCLK_DIV1;

  if (HAL_RCC_ClockConfig(&RCC_ClkInitStruct, FLASH_LATENCY_1) != HAL_OK)
  {
    Error_Handler();
  }
  PeriphClkInit.PeriphClockSelection = RCC_PERIPHCLK_USART2|RCC_PERIPHCLK_I2C1;
  PeriphClkInit.Usart2ClockSelection = RCC_USART2CLKSOURCE_PCLK1;
  PeriphClkInit.I2c1ClockSelection = RCC_I2C1CLKSOURCE_PCLK1;
  if (HAL_RCCEx_PeriphCLKConfig(&PeriphClkInit) != HAL_OK)
  {
    Error_Handler();
  }
  /** Configure the main internal regulator output voltage
  */
  if (HAL_PWREx_ControlVoltageScaling(PWR_REGULATOR_VOLTAGE_SCALE1) != HAL_OK)
  {
    Error_Handler();
  }
}

/**
  * @brief  This function is executed in case of error occurrence.
  * @retval None
  */
void Error_Handler(void)
{
  /* USER CODE BEGIN Error_Handler_Debug */
  /* User can add his own implementation to report the HAL error return state */

  /* USER CODE END Error_Handler_Debug */
}

#ifdef  USE_FULL_ASSERT
/**
  * @brief  Reports the name of the source file and the source line number
  *         where the assert_param error has occurred.
  * @param  file: pointer to the source file name
  * @param  line: assert_param error line source number
  * @retval None
  */
void assert_failed(uint8_t *file, uint32_t line)
{
  /* USER CODE BEGIN 6 */
  /* User can add his own implementation to report the file name and line number,
     tex: printf("Wrong parameters value: file %s on line %d\r\n", file, line) */
  /* USER CODE END 6 */
}
#endif /* USE_FULL_ASSERT */

/************************ (C) COPYRIGHT STMicroelectronics *****END OF FILE****/
